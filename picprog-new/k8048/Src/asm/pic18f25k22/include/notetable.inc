NOTEFIRST EQU .24
NOTELAST  EQU .107
NOTETABLE
;OCTAVE -3 (0)
;MIDI= 24(0x18) NOTE=C     RELOAD=0x111C (f=32.703~32.703)
       DW  0x111C
;MIDI= 25(0x19) NOTE=C#/Db RELOAD=0x1E84 (f=34.648~34.648)
       DW  0x1E84
;MIDI= 26(0x1a) NOTE=D     RELOAD=0x2B2C (f=36.708~36.708)
       DW  0x2B2C
;MIDI= 27(0x1b) NOTE=D#/Eb RELOAD=0x371E (f=38.891~38.891)
       DW  0x371E
;MIDI= 28(0x1c) NOTE=E     RELOAD=0x4264 (f=41.203~41.203)
       DW  0x4264
;MIDI= 29(0x1d) NOTE=F     RELOAD=0x4D09 (f=43.654~43.654)
       DW  0x4D09
;MIDI= 30(0x1e) NOTE=F#/Gb RELOAD=0x5714 (f=46.249~46.249)
       DW  0x5714
;MIDI= 31(0x1f) NOTE=G     RELOAD=0x608F (f=48.999~48.999)
       DW  0x608F
;MIDI= 32(0x20) NOTE=G#,Ab RELOAD=0x6982 (f=51.913~51.913)
       DW  0x6982
;MIDI= 33(0x21) NOTE=A     RELOAD=0x71F4 (f=55.000~54.999)
       DW  0x71F4
;MIDI= 34(0x22) NOTE=A#/Bb RELOAD=0x79ED (f=58.270~58.270)
       DW  0x79ED
;MIDI= 35(0x23) NOTE=B     RELOAD=0x8174 (f=61.735~61.736)
       DW  0x8174
;OCTAVE -2 (1)
;MIDI= 36(0x24) NOTE=C     RELOAD=0x888E (f=65.406~65.407)
       DW  0x888E
;MIDI= 37(0x25) NOTE=C#/Db RELOAD=0x8F42 (f=69.296~69.295)
       DW  0x8F42
;MIDI= 38(0x26) NOTE=D     RELOAD=0x9596 (f=73.416~73.416)
       DW  0x9596
;MIDI= 39(0x27) NOTE=D#/Eb RELOAD=0x9B8F (f=77.782~77.782)
       DW  0x9B8F
;MIDI= 40(0x28) NOTE=E     RELOAD=0xA132 (f=82.407~82.406)
       DW  0xA132
;MIDI= 41(0x29) NOTE=F     RELOAD=0xA684 (f=87.307~87.306)
       DW  0xA684
;MIDI= 42(0x2a) NOTE=F#/Gb RELOAD=0xAB8A (f=92.499~92.498)
       DW  0xAB8A
;MIDI= 43(0x2b) NOTE=G     RELOAD=0xB048 (f=97.999~98.001)
       DW  0xB048
;MIDI= 44(0x2c) NOTE=G#,Ab RELOAD=0xB4C1 (f=103.826~103.826)
       DW  0xB4C1
;MIDI= 45(0x2d) NOTE=A     RELOAD=0xB8FA (f=110.000~109.999)
       DW  0xB8FA
;MIDI= 46(0x2e) NOTE=A#/Bb RELOAD=0xBCF7 (f=116.541~116.543)
       DW  0xBCF7
;MIDI= 47(0x2f) NOTE=B     RELOAD=0xC0BA (f=123.471~123.472)
       DW  0xC0BA
;OCTAVE -1 (2)
;MIDI= 48(0x30) NOTE=C     RELOAD=0xC447 (f=130.813~130.813)
       DW  0xC447
;MIDI= 49(0x31) NOTE=C#/Db RELOAD=0xC7A1 (f=138.591~138.591)
       DW  0xC7A1
;MIDI= 50(0x32) NOTE=D     RELOAD=0xCACB (f=146.832~146.832)
       DW  0xCACB
;MIDI= 51(0x33) NOTE=D#/Eb RELOAD=0xCDC8 (f=155.563~155.569)
       DW  0xCDC8
;MIDI= 52(0x34) NOTE=E     RELOAD=0xD099 (f=164.814~164.813)
       DW  0xD099
;MIDI= 53(0x35) NOTE=F     RELOAD=0xD342 (f=174.614~174.611)
       DW  0xD342
;MIDI= 54(0x36) NOTE=F#/Gb RELOAD=0xD5C5 (f=184.997~184.997)
       DW  0xD5C5
;MIDI= 55(0x37) NOTE=G     RELOAD=0xD824 (f=195.998~196.002)
       DW  0xD824
;MIDI= 56(0x38) NOTE=G#,Ab RELOAD=0xDA61 (f=207.652~207.663)
       DW  0xDA61
;MIDI= 57(0x39) NOTE=A     RELOAD=0xDC7D (f=220.000~219.998)
       DW  0xDC7D
;MIDI= 58(0x3a) NOTE=A#/Bb RELOAD=0xDE7B (f=233.082~233.073)
       DW  0xDE7B
;MIDI= 59(0x3b) NOTE=B     RELOAD=0xE05D (f=246.942~246.944)
       DW  0xE05D
;OCTAVE 0 (3) MIDDLE C
;MIDI= 60(0x3c) NOTE=C     RELOAD=0xE223 (f=261.626~261.609)
       DW  0xE223
;MIDI= 61(0x3d) NOTE=C#/Db RELOAD=0xE3D1 (f=277.183~277.200)
       DW  0xE3D1
;MIDI= 62(0x3e) NOTE=D     RELOAD=0xE566 (f=293.665~293.686)
       DW  0xE566
;MIDI= 63(0x3f) NOTE=D#/Eb RELOAD=0xE6E4 (f=311.127~311.139)
       DW  0xE6E4
;MIDI= 64(0x40) NOTE=E     RELOAD=0xE84D (f=329.628~329.652)
       DW  0xE84D
;MIDI= 65(0x41) NOTE=F     RELOAD=0xE9A1 (f=349.228~349.223)
       DW  0xE9A1
;MIDI= 66(0x42) NOTE=F#/Gb RELOAD=0xEAE3 (f=369.994~370.028)
       DW  0xEAE3
;MIDI= 67(0x43) NOTE=G     RELOAD=0xEC12 (f=391.995~392.003)
       DW  0xEC12
;MIDI= 68(0x44) NOTE=G#,Ab RELOAD=0xED30 (f=415.305~415.282)
       DW  0xED30
;MIDI= 69(0x45) NOTE=A     RELOAD=0xEE3F (f=440.000~440.044)
       DW  0xEE3F
;MIDI= 70(0x46) NOTE=A#/Bb RELOAD=0xEF3E (f=466.164~466.200)
       DW  0xEF3E
;MIDI= 71(0x47) NOTE=B     RELOAD=0xF02E (f=493.883~493.827)
       DW  0xF02E
;OCTAVE 1 (4)
;MIDI= 72(0x48) NOTE=C     RELOAD=0xF112 (f=523.251~523.286)
       DW  0xF112
;MIDI= 73(0x49) NOTE=C#/Db RELOAD=0xF1E8 (f=554.365~554.324)
       DW  0xF1E8
;MIDI= 74(0x4a) NOTE=D     RELOAD=0xF2B3 (f=587.330~587.372)
       DW  0xF2B3
;MIDI= 75(0x4b) NOTE=D#/Eb RELOAD=0xF372 (f=622.254~622.278)
       DW  0xF372
;MIDI= 76(0x4c) NOTE=E     RELOAD=0xF426 (f=659.255~659.196)
       DW  0xF426
;MIDI= 77(0x4d) NOTE=F     RELOAD=0xF4D1 (f=698.456~698.568)
       DW  0xF4D1
;MIDI= 78(0x4e) NOTE=F#/Gb RELOAD=0xF571 (f=739.989~739.919)
       DW  0xF571
;MIDI= 79(0x4f) NOTE=G     RELOAD=0xF609 (f=783.991~784.006)
       DW  0xF609
;MIDI= 80(0x50) NOTE=G#,Ab RELOAD=0xF698 (f=830.609~830.565)
       DW  0xF698
;MIDI= 81(0x51) NOTE=A     RELOAD=0xF71F (f=880.000~879.894)
       DW  0xF71F
;MIDI= 82(0x52) NOTE=A#/Bb RELOAD=0xF79F (f=932.328~932.401)
       DW  0xF79F
;MIDI= 83(0x53) NOTE=B     RELOAD=0xF817 (f=987.767~987.654)
       DW  0xF817
;OCTAVE 2 (5)
;MIDI= 84(0x54) NOTE=C     RELOAD=0xF889 (f=1046.502~1046.573)
       DW  0xF889
;MIDI= 85(0x55) NOTE=C#/Db RELOAD=0xF8F4 (f=1108.730~1108.647)
       DW  0xF8F4
;MIDI= 86(0x56) NOTE=D     RELOAD=0xF959 (f=1174.659~1174.398)
       DW  0xF959
;MIDI= 87(0x57) NOTE=D#/Eb RELOAD=0xF9B9 (f=1244.508~1244.555)
       DW  0xF9B9
;MIDI= 88(0x58) NOTE=E     RELOAD=0xFA13 (f=1318.510~1318.392)
       DW  0xFA13
;MIDI= 89(0x59) NOTE=F     RELOAD=0xFA68 (f=1396.913~1396.648)
       DW  0xFA68
;MIDI= 90(0x5a) NOTE=F#/Gb RELOAD=0xFAB9 (f=1479.978~1480.385)
       DW  0xFAB9
;MIDI= 91(0x5b) NOTE=G     RELOAD=0xFB04 (f=1567.982~1567.398)
       DW  0xFB04
;MIDI= 92(0x5c) NOTE=G#,Ab RELOAD=0xFB4C (f=1661.219~1661.130)
       DW  0xFB4C
;MIDI= 93(0x5d) NOTE=A     RELOAD=0xFB90 (f=1760.000~1760.563)
       DW  0xFB90
;MIDI= 94(0x5e) NOTE=A#/Bb RELOAD=0xFBCF (f=1864.655~1863.933)
       DW  0xFBCF
;MIDI= 95(0x5f) NOTE=B     RELOAD=0xFC0C (f=1975.533~1976.285)
       DW  0xFC0C
;OCTAVE 3 (6)
;MIDI= 96(0x60) NOTE=C     RELOAD=0xFC44 (f=2093.005~2092.050)
       DW  0xFC44
;MIDI= 97(0x61) NOTE=C#/Db RELOAD=0xFC7A (f=2217.461~2217.295)
       DW  0xFC7A
;MIDI= 98(0x62) NOTE=D     RELOAD=0xFCAD (f=2349.318~2350.176)
       DW  0xFCAD
;MIDI= 99(0x63) NOTE=D#/Eb RELOAD=0xFCDC (f=2489.016~2487.562)
       DW  0xFCDC
;MIDI=100(0x64) NOTE=E     RELOAD=0xFD0A (f=2637.021~2638.522)
       DW  0xFD0A
;MIDI=101(0x65) NOTE=F     RELOAD=0xFD34 (f=2793.826~2793.296)
       DW  0xFD34
;MIDI=102(0x66) NOTE=F#/Gb RELOAD=0xFD5C (f=2959.955~2958.580)
       DW  0xFD5C
;MIDI=103(0x67) NOTE=G     RELOAD=0xFD82 (f=3135.963~3134.796)
       DW  0xFD82
;MIDI=104(0x68) NOTE=G#,Ab RELOAD=0xFDA6 (f=3322.438~3322.259)
       DW  0xFDA6
;MIDI=105(0x69) NOTE=A     RELOAD=0xFDC8 (f=3520.000~3521.127)
       DW  0xFDC8
;MIDI=106(0x6a) NOTE=A#/Bb RELOAD=0xFDE8 (f=3729.310~3731.343)
       DW  0xFDE8
;MIDI=107(0x6b) NOTE=B     RELOAD=0xFE06 (f=3951.066~3952.569)
       DW  0xFE06
