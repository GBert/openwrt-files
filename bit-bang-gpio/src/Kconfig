## bit-bang-gpio/src/Kconfig
```kconfig
config BIT_BANG_GPIO
    tristate "Bit-bang GPIO"
    depends on GENERIC_GPIO
    select BIT_BANG_GPIO
    help
      Bit-bang GPIO driver
```

## i2card/src/Kconfig
```kconfig
config I2CARD
    tristate "I2C loco card interface"
    depends on I2C
    select I2CARD
    help
      Fast I2C loco card interface
```

## mc-icsp-custom/src/Kconfig
```kconfig
config MC_ICSP_CUSTOM
    tristate "Microchip ICSP driver / GPIO customizing"
    depends on GENERIC_GPIO
    select MC_ICSP_CUSTOM
    help
      This is a GPIO lines Microchip ICSP Customizing tool. 

      This support is also available as a module.  If so, the module
      will be called mc-icsp-gpio-custom.
```

## picprog-new/k8048/Src/lpicp/openwrt-files/mc-icsp-custom/src/Kconfig
```kconfig
config MC_ICSP_GPIO_CUSTOM
    tristate "Microchip ICSP driver / GPIO customizing"
    depends on GENERIC_GPIO MC_ICSP
    select MC_ICSP_GPIO_CUSTOM
    help
      This is a GPIO lines Microchip ICSP Customizing tool. 

      This support is also available as a module.  If so, the module
      will be called mc-icsp-gpio-custom.
```

## picprog-new/k8048/Src/lpicp/openwrt-files/mc-icsp/src/Kconfig
```kconfig
config MC_ICSP
    tristate "Microchip ICSP driver"
    depends on GENERIC_GPIO
    select MC_ICSP
    help
      This is a Microchip ICSP driver used to programm
      Microchip PIC Controllers
```

## rwmtd0/src/Kconfig
```kconfig
config RWMTD0
    tristate "R/W for mtd0"
    select RWMTD0
    help
      R/W for mtd0
```
